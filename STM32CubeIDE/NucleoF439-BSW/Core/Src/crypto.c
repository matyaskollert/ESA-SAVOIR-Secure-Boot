/*
 * crypto.c
 *
 *  Created on: Jan 26, 2026
 *      Author: Matyas
 *
 * Digital-signature verification.
 * Compile with -DPOST_QUANTUM to use ML-DSA-65 instead of ECDSA-P256.
 * Compile with -DHYBRID to verify both signatures (ECDSA first, then ML-DSA).
 *
 * Key update workflow
 * ───────────────────
 * 1. Generate a new key pair with the uploader (main.py) or manually.
 * 2. Run  python pem_to_c_array.py keys/public_key_<ts>.pem   (ECDSA)
 *         python pem_to_c_array.py keys/public_key_<ts>.bin   (ML-DSA)
 * 3. Replace the relevant eccPubKey[] array and mldsaPubKey[] array below with the printed output.
 */

#include "crypto.h"
#include <wolfssl/wolfcrypt/sha256.h>

/* =========================================================================
 * Public key — classical ECDSA-P256 (DER-encoded SubjectPublicKeyInfo)
 * ========================================================================= */
#if !defined(POST_QUANTUM) || defined(HYBRID)

	#include <wolfssl/wolfcrypt/asn_public.h>
	#include <wolfssl/wolfcrypt/ecc.h>

	/* Replace with output of:  python pem_to_c_array.py keys/public_key_<ts>.pem */
	const byte eccPubKey[] = {
		0x30, 0x59, 0x30, 0x13, 0x06, 0x07, 0x2a, 0x86, 0x48, 0xce, 0x3d, 0x02,
		0x01, 0x06, 0x08, 0x2a, 0x86, 0x48, 0xce, 0x3d, 0x03, 0x01, 0x07, 0x03,
		0x42, 0x00, 0x04, 0x61, 0x57, 0xcb, 0x35, 0xae, 0x44, 0x7f, 0xd9, 0xdc,
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		0x1e, 0xf3, 0x33, 0x78, 0x22, 0xcd, 0xb6
	};

#endif /* !POST_QUANTUM || HYBRID */

/* =========================================================================
 * Public key — ML-DSA-65 (raw 1952-byte public key, NIST level 3)
 *
 * Replace with output of:  python pem_to_c_array.py keys/public_key_<ts>.bin
 * ========================================================================= */
#if defined(POST_QUANTUM) || defined(HYBRID)
	const byte mldsaPubKey[ML_DSA_65_PUB_KEY_SIZE] = {
		0xbd, 0x21, 0x7e, 0x67, 0x52, 0x96, 0xca, 0x03, 0xec, 0x77, 0x61, 0x2d,
		0x02, 0x78, 0xbf, 0x22, 0x88, 0x38, 0xd2, 0x46, 0x16, 0x14, 0x2c, 0x39,
		0x5a, 0x83, 0x8b, 0xf6, 0xfd, 0x0c, 0x85, 0xce, 0xe5, 0x8f, 0xd5, 0x72,
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		0xf6, 0xea, 0x22, 0xef, 0xc9, 0xd5, 0x71, 0xe8
	};
#endif /* POST_QUANTUM || HYBRID */

/* =========================================================================
 * SHA-256 utilities (used for CRC/hash display; ML-DSA hashes internally)
 * ========================================================================= */
byte hashDigest[WC_SHA256_DIGEST_SIZE];
Sha256 sha;

void printSha256(const uint8_t *digest)
{
    for (uint32_t i = 0; i < WC_SHA256_DIGEST_SIZE; i++)
    {
        printf("%02x", digest[i]);
    }
    printf("\r\n");
}

byte* hash(const byte* buffer, uint32_t bufferSize)
{
	int ret = wc_InitSha256(&sha);
	if (ret != 0)
	{
		printf("wc_InitSha256 failed: %d\r\n", ret);
		return NULL;
	}

	ret = wc_Sha256Update(&sha, buffer, bufferSize);
	if (ret != 0)
	{
		printf("wc_Sha256Update failed: %d\r\n", ret);
		return NULL;
	}

	ret = wc_Sha256Final(&sha, hashDigest);
	if (ret != 0)
	{
		printf("wc_Sha256Final failed: %d\r\n", ret);
		return NULL;
	}

	printSha256(hashDigest);
	return hashDigest;
}

/* =========================================================================
 * Hybrid signature layout
 *
 * When HYBRID is defined the 4096-byte signature field carries both
 * signatures concatenated at fixed offsets:
 *
 *   [ 0 .. HYBRID_ECDSA_MAX_BYTES - 1 ]   ECDSA-P256 DER signature
 *                                          (self-describing; max 72 bytes)
 *   [ HYBRID_MLDSA_OFFSET .. + 3308  ]     ML-DSA-65 raw signature
 *                                          (DILITHIUM_LEVEL3_SIG_SIZE = 3309 bytes)
 *   Total used: 72 + 3309 = 3381 bytes — fits comfortably in 4096 bytes.
 * ========================================================================= */
#define HYBRID_ECDSA_MAX_BYTES   72u
#define HYBRID_MLDSA_OFFSET      HYBRID_ECDSA_MAX_BYTES

/* =========================================================================
 * Static helper — verify ECDSA-P256 signature over a SHA-256 digest.
 *
 * @param digest        32-byte SHA-256 hash of the signed data.
 * @param signature     DER-encoded ECDSA signature bytes.
 * @param signatureLen  Length of the DER envelope in bytes.
 * @return 1 on success, 0 on failure.
 * ========================================================================= */
#if !defined(POST_QUANTUM) || defined(HYBRID)
static int16_t verifyEcdsa(const byte *digest,
                            const byte *signature, uint32_t signatureLen)
{
    ecc_key eccKey;
    word32  inOutIdx = 0;
    int     ret, verified = 0;

    ret = wc_EccPublicKeyDecode(eccPubKey, &inOutIdx, &eccKey, sizeof(eccPubKey));
    if (ret != 0)
    {
        printf("wc_EccPublicKeyDecode failed: %d\r\n", ret);
        return 0;
    }

    ret = wc_ecc_set_curve(&eccKey, 32, ECC_SECP256R1);
    if (ret != 0)
    {
        printf("wc_ecc_set_curve failed: %d\r\n", ret);
        wc_ecc_free(&eccKey);
        return 0;
    }

    ret = wc_ecc_verify_hash(signature, signatureLen,
                             digest, WC_SHA256_DIGEST_SIZE,
                             &verified, &eccKey);
    wc_ecc_free(&eccKey);

    if (ret != 0)
    {
        printf("wc_ecc_verify_hash failed: %d\r\n", ret);
        return 0;
    }
    if (verified == 0)
    {
        printf("ECDSA-P256 signature is invalid\r\n");
        return 0;
    }
    printf("ECDSA-P256 signature valid\r\n");
    return 1;
}
#endif /* !POST_QUANTUM || HYBRID */

/* =========================================================================
 * Static helper — verify ML-DSA-65 signature over the full message.
 *
 * ML-DSA performs its own internal SHAKE-based hashing, so the raw message
 * bytes must be passed (not a pre-computed digest).
 *
 * @param buffer      Pointer to the signed data.
 * @param bufferSize  Length of the signed data in bytes.
 * @param signature   Pointer to the raw 3309-byte ML-DSA-65 signature.
 * @return 1 on success, 0 on failure.
 * ========================================================================= */
#if defined(POST_QUANTUM) || defined(HYBRID)
static int16_t verifyMldsa(const byte *buffer, uint32_t bufferSize,
                            const byte *signature)
{
    dilithium_key dilKey;
    int           ret, verified = 0;

    ret = wc_dilithium_init(&dilKey);
    if (ret != 0)
    {
        printf("wc_dilithium_init failed: %d\r\n", ret);
        return 0;
    }

    ret = wc_dilithium_set_level(&dilKey, 3); /* 3 → ML-DSA-65 */
    if (ret != 0)
    {
        printf("wc_dilithium_set_level failed: %d\r\n", ret);
        wc_dilithium_free(&dilKey);
        return 0;
    }

    ret = wc_dilithium_import_public(mldsaPubKey, sizeof(mldsaPubKey), &dilKey);
    if (ret != 0)
    {
        printf("wc_dilithium_import_public failed: %d\r\n", ret);
        wc_dilithium_free(&dilKey);
        return 0;
    }

    ret = wc_dilithium_verify_msg(signature, DILITHIUM_LEVEL3_SIG_SIZE,
                                  buffer, bufferSize,
                                  &verified, &dilKey);
    wc_dilithium_free(&dilKey);

    if (ret != 0)
    {
        printf("wc_dilithium_verify_msg failed: %d\r\n", ret);
        return 0;
    }
    if (verified == 0)
    {
        printf("ML-DSA-65 signature is invalid\r\n");
        return 0;
    }
    printf("ML-DSA-65 signature valid\r\n");
    return 1;
}
#endif /* POST_QUANTUM || HYBRID */

/* =========================================================================
 * Public API — verify the image signature.
 *
 * Compile-time dispatch:
 *   HYBRID defined          → ECDSA-P256 first, then ML-DSA-65 (both must pass)
 *   POST_QUANTUM undefined  → ECDSA-P256 only
 *   POST_QUANTUM defined    → ML-DSA-65 only
 * ========================================================================= */
int16_t verifySignature(const byte *buffer, uint32_t bufferSize,
                        const byte *signature)
{
#if defined(HYBRID)
    /* ── Hybrid: ECDSA-P256 + ML-DSA-65 ─────────────────────────────────── */
    printf("Using hybrid signature scheme (ECDSA-P256 + ML-DSA-65)\r\n");

    /* Step 1 - ECDSA-P256 ------------------------------------------------- */
    if (signature[0] != 0x30)
    {
        printf("ECDSA: invalid DER tag 0x%02x (expected 0x30)\r\n", signature[0]);
        return 0;
    }
    uint32_t ecdsaSigLen = (uint32_t)signature[1] + 2u; /* tag + len byte + payload */

    printf("Step 1 - ECDSA-P256: buf=%lu bytes, sig=%lu bytes\r\n",
           bufferSize, ecdsaSigLen);

    hash(buffer, bufferSize); /* fills hashDigest[] */

    if (verifyEcdsa(hashDigest, signature, ecdsaSigLen) != 1)
    {
        printf("HYBRID: ECDSA-P256 failed - image rejected\r\n");
        return 0;
    }

    /* Step 2 - ML-DSA-65 -------------------------------------------------- */
    const byte *mldsaSig = signature + HYBRID_MLDSA_OFFSET;

    printf("Step 2 - ML-DSA-65:  buf=%lu bytes, sig=%d bytes\r\n",
           bufferSize, DILITHIUM_LEVEL3_SIG_SIZE);

    if (verifyMldsa(buffer, bufferSize, mldsaSig) != 1)
    {
        printf("HYBRID: ML-DSA-65 failed - image rejected\r\n");
        return 0;
    }

    printf("HYBRID: both signatures valid - image accepted\r\n");
    return 1;

#elif !defined(POST_QUANTUM)
    /* ── Classical ECDSA-P256 only ───────────────────────────────────────── */
    printf("Using ECDSA-P256 signature scheme\r\n");

    if (signature[0] != 0x30)
    {
        printf("ECDSA: invalid DER tag 0x%02x (expected 0x30)\r\n", signature[0]);
        return 0;
    }
    uint32_t signatureLen = (uint32_t)signature[1] + 2u;

    /* Debug: print the raw signature bytes */
    // printf("Signature (%lu bytes): ", signatureLen);
    // for (uint32_t i = 0; i < signatureLen; i++)
    //     printf("%02x", signature[i]);
    // printf("\r\n");

    // uint32_t start = HAL_GetTick();
    hash(buffer, bufferSize); /* fills hashDigest[] */
    // uint32_t end   = HAL_GetTick();
    // printf("SHA-256: %lu ms\r\n", end - start);

    return verifyEcdsa(hashDigest, signature, signatureLen);

#else /* POST_QUANTUM */
    /* ── Post-quantum ML-DSA-65 only ─────────────────────────────────────── */
    printf("Using ML-DSA-65 signature scheme\r\n");
    printf("ML-DSA-65 verify: buf=%lu bytes, sig=%d bytes\r\n",
           bufferSize, DILITHIUM_LEVEL3_SIG_SIZE);

    return verifyMldsa(buffer, bufferSize, signature);

#endif /* HYBRID / !POST_QUANTUM / POST_QUANTUM */
}
